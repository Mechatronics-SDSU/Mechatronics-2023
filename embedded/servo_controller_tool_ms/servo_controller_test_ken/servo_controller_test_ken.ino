#include <Servo.h>
#include <SPI.h>
#include <SimpleRotary.h>
SimpleRotary rotary(2,3,4);

//For screen
#include <Adafruit_SSD1306.h>
#define SCREEN_WIDTH 128 // OLED display width, in pixels
#define SCREEN_HEIGHT 64 // OLED display height, in pixels
#define OLED_RESET     -1 // Reset pin # (or -1 if sharing Arduino reset pin)(1 disables blink)
#define SCREEN_ADDRESS 0x3C ///< See datasheet for Address; 0x3D for 128x64, 0x3C for 128x32
Adafruit_SSD1306 display(SCREEN_WIDTH, SCREEN_HEIGHT, &Wire, OLED_RESET);

static const unsigned char PROGMEM ContinuousMotor_1[] = {
0b00000000, 0b00001111, 0b11110000, 0b00000000,
0b00000000, 0b01111111, 0b11111110, 0b00000000,
0b00000001, 0b11110001, 0b00001111, 0b10000000,
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0b00000000, 0b00001111, 0b11110000, 0b00000000,
};
static const unsigned char PROGMEM ContinuousMotor_2[] = {
0b00000000, 0b00001111, 0b11110000, 0b00000000,
0b00000000, 0b01111111, 0b11111110, 0b00000000,
0b00000001, 0b11110001, 0b00001111, 0b10000000,
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0b00000000, 0b00001111, 0b11110000, 0b00000000,
};
static const unsigned char PROGMEM ContinuousMotor_3[] = {
0b00000000, 0b00001111, 0b11110000, 0b00000000,
0b00000000, 0b01111111, 0b11111110, 0b00000000,
0b00000001, 0b11110001, 0b00001111, 0b10000000,
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0b00000000, 0b00001111, 0b11110000, 0b00000000,
};
static const unsigned char PROGMEM ContinuousMotor_4[] = {
0b00000000, 0b00001111, 0b11110000, 0b00000000,
0b00000000, 0b01111111, 0b11111110, 0b00000000,
0b00000001, 0b11110001, 0b00001111, 0b10000000,
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0b00000000, 0b00001111, 0b11110000, 0b00000000,
};

int pos = 0;
int power = 0;
int frame = 1;
int frameratemax = 30;
int image_size = 32;
//delay alternative setup
unsigned long previousMillis = 0UL;
unsigned long interval = 100UL;
Servo mainservo;
void setup() {
  Serial.begin(9600);
  mainservo.attach(9);

  //For Screen
  display.begin(SSD1306_SWITCHCAPVCC, SCREEN_ADDRESS);
  display.clearDisplay(); //Clear display
  display.setTextSize(1);             // Normal 1:1 pixel scale
  display.setTextColor(SSD1306_WHITE);        // Draw white text, required

  display.setCursor(0,0);  // Start at top-left corner
  display.println(F("Initializing...4s")); //prints text on same line
  display.display(); //prints display
  pos = 1500;
  mainservo.writeMicroseconds(pos); // send "stop" signal to ESC.
  //mainservo.writeMicroseconds(2000); // send "stop" signal to ESC.
  delay(4000); // delay to allow the ESC to recognize the stopped signal
  
}

void loop() {
  // changes the servo position when rotary is rotated
    byte i; // 0 = not turning, 1 = CW, 2 = CCW
  i = rotary.rotate();
  if ( i == 1 ) {
    pos += 20;
  }
  if ( i == 2 ) {
    pos -= 20;
  }
  // sets min and max positions 
  if (pos >= 1900){
   pos = 1900;
   }
  else if (pos <=1100){
    pos = 1100;
  }
  //mainservo.write(pos);
  mainservo.writeMicroseconds(pos); // Send signal to ESC.

  unsigned long currentMillis = millis();
  if(currentMillis - previousMillis > interval)
  {
  /* The Arduino executes this code once every second
  *  (interval = 1000 (ms) = 1 second).
  */
  display.clearDisplay(); //Clear display
  display.setCursor(0,0);  // Start at top-left corner
  display.println(F("Servo Controller: ")); //prints text on same line
  //display.print(F("Knob Offset: ")); //prints text on same line
  //display.print(pos); //prints new line
  //display.println(" "); //prints new line
  display.print(F("Signal: ")); //prints text on same line
  display.print(pos); //prints new line
  display.println(" uS"); //prints new line
  display.print(F("Power: ")); //prints text on same line
  power = (pos - 1500)/4;
  display.print(power); //prints new line
  display.println(" %"); //prints new line
  if (frame >= 0 && frame <= 1){
    testdrawbitmap(ContinuousMotor_1);
  }
  else if (frame > 1 && frame <= 2){
  testdrawbitmap(ContinuousMotor_2);
  }
  else if (frame > 2 && frame <= 3){
    testdrawbitmap(ContinuousMotor_3);
  }
  else{
    testdrawbitmap(ContinuousMotor_4);
    frame = 0;
  }
  display.display(); //prints display
  // Don't forget to update the previousMillis value
  frame ++;
  previousMillis = currentMillis;
  Serial.write(frame);
  }
  
}





void testdrawbitmap(const uint8_t *bitmap) {
  //display.clearDisplay();
  display.drawBitmap(
    (display.width() - image_size),
    (display.height() - image_size),
    bitmap, image_size, image_size, 1);
}
